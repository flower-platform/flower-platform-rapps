#include <Arduino.h>
#include <HardwareSerial.h>
#include <stdbool.h>

#include <Output.h>
#include <HttpServer.h>
#include <EthernetNetworkAdapter.h>


class AppGen {
public: 
	
	Output M1A;
	Output M1B;
	Output M2A;
	Output M2B;
	HttpServer httpServer;
	EthernetNetworkAdapter ethernetNetworkAdapter1;


	void goLeft() {
        M1A.setValue(0);
        M1B.setValue(255);
        M2A.setValue(0);
        M2B.setValue(0);
        delay(1200);
        goFront();

	}

	void goFront() {
        M1A.setValue(0);
        M2A.setValue(0);
        M1B.setValue(255);
        M2B.setValue(255);

	}

	void goBack() {
        M1A.setValue(255);
        M1B.setValue(0);
        M2A.setValue(255);
        M2B.setValue(0);

	}

	void goRight() {
        M1A.setValue(0);
        M1B.setValue(0);
        M2A.setValue(0);
        M2B.setValue(255);
        delay(1200);
        goFront();

	}

	void stop() {
        M1A.setValue(0);
        M1B.setValue(0);
        M2A.setValue(0);
        M2B.setValue(0);

	}


	void httpServer_onCommandReceived(HttpCommandEvent* event) {
		char command[32];
		event->server->getCommandFromUrl(event->url, command);
		bool urlFound = false;
		
		BufferedPrint out(event->client);
		if (strcmp_P(command, PSTR("")) == 0) {
			event->server->httpSuccess(&out, HttpServer::CONTENT_TYPE_HTML, true);
			static const uint8_t HTML_PAGE[] PROGMEM = {
				31,139,8,0,0,0,0,0,0,0,205,88,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114,
				34,54,114,50,243,94,123,127,110,230,94,202,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48,
				51,103,71,245,217,56,207,148,60,78,16,160,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91,
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				128,22,71,184,88,99,133,10,12,235,189,71,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0
			};
			out.write_P(HTML_PAGE, (sizeof(HTML_PAGE)/sizeof(*HTML_PAGE)));
			out.flush();
			return;
		} else if (strcmp_P(command, PSTR("goLeft")) == 0) {
			urlFound = true;
			goLeft();
		} else if (strcmp_P(command, PSTR("goFront")) == 0) {
			urlFound = true;
			goFront();
		} else if (strcmp_P(command, PSTR("goBack")) == 0) {
			urlFound = true;
			goBack();
		} else if (strcmp_P(command, PSTR("goRight")) == 0) {
			urlFound = true;
			goRight();
		} else if (strcmp_P(command, PSTR("stop")) == 0) {
			urlFound = true;
			stop();
		} else if (strcmp_P(command, PSTR("getDescriptors")) == 0) {
			printDescriptorsAsJson(&out);
			out.flush();
			return;
		} else if (strcmp_P(command, PSTR("getState")) == 0) {
			urlFound = true;
		}
		
		if (urlFound) {
			event->server->httpSuccess(&out);
			printStateAsJson(&out);
		} else {
			event->server->httpError404(&out);
		}
		out.flush();
	}
	
	void printDescriptorsAsJson(Print* print) {
		print->print(F("{\"inputs\":["));

		print->print(F("],\"commands\":["));
		print->print(F("{\"label\":\"goLeft\", \"command\":\"goLeft\", \"parameters\":\"\"}"));
		print->print(F(",{\"label\":\"goFront\", \"command\":\"goFront\", \"parameters\":\"\"}"));
		print->print(F(",{\"label\":\"goBack\", \"command\":\"goBack\", \"parameters\":\"\"}"));
		print->print(F(",{\"label\":\"goRight\", \"command\":\"goRight\", \"parameters\":\"\"}"));
		print->print(F(",{\"label\":\"stop\", \"command\":\"stop\", \"parameters\":\"\"}"));
		
		print->print(F("]}"));

	}
	
	void printStateAsJson(Print* print) {
		print->print(F("{"));
	
		write_P(print, PSTR("\"freeMem\": "));
		print->print(freeRam());
		print->print("}");
	}

	void setup() {
		M1A.pin = 3;
		M1A.initialValue = 0;
		M1A.isPwm = true;

		M1B.pin = 5;
		M1B.initialValue = 0;
		M1B.isPwm = true;

		M2A.pin = 6;
		M2A.initialValue = 0;
		M2A.isPwm = true;

		M2B.pin = 9;
		M2B.initialValue = 0;
		M2B.isPwm = true;

		httpServer.port = 80;
		httpServer.onCommandReceived = new DelegatingCallback<AppGen, HttpCommandEvent>(this, &AppGen::httpServer_onCommandReceived); 

		ethernetNetworkAdapter1.macAddressStr = "00:0a:95:9d:68:16";
		ethernetNetworkAdapter1.protocolHandler = &httpServer;
		ethernetNetworkAdapter1.ipAddressStr = "192.168.100.252";

		M1A.setup();
		M1B.setup();
		M2A.setup();
		M2B.setup();
		ethernetNetworkAdapter1.setup();
	}

	void loop() {
		M1A.loop();
		M1B.loop();
		M2A.loop();
		M2B.loop();
		ethernetNetworkAdapter1.loop();
	}
	
};

#include "CustomCode.h"

App app;

void setup() {
	Serial.begin(115200);
	app.setup();
}

void loop() {
	app.loop();
}
