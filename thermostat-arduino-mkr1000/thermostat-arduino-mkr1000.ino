#include <Arduino.h>
#include <HardwareSerial.h>
#include <stdbool.h>

#include <DHTSensor.h>
#include <Output.h>
#include <HttpServer.h>
#include <WiFi101NetworkAdapter.h>
#include <Timer.h>


class AppGen {
public: 
	
	DHTSensor sensor;
	Output relay;
	HttpServer httpServer;
	WiFi101NetworkAdapter networkAdapter;
	Timer timer;

	int currentTemperature;
	int presetTemperature;

	void setDesiredTemperature(int temperature) {
        presetTemperature = temperature;

	}

	void sensor_onTemperatureChanged(ValueChangedEvent* event) {
        Serial.println(event->currentValue);
        currentTemperature = event->currentValue;

	}
	void timer_onTimer(TimerEvent* event) {
        if ( (currentTemperature >= presetTemperature) ) {
            relay.setValue(HIGH);
        } else {
            relay.setValue(LOW);
        }

	}

	void httpServer_onCommandReceived(HttpCommandEvent* event) {
		char command[32];
		event->server->getCommandFromUrl(event->url, command);
		bool urlFound = false;
		
		BufferedPrint out(event->client);
		if (strcmp_P(command, PSTR("")) == 0) {
			event->server->httpSuccess(&out, HttpServer::CONTENT_TYPE_HTML, true);
			static const uint8_t HTML_PAGE[] PROGMEM = {
				31,139,8,0,0,0,0,0,0,0,205,88,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148,
				172,88,171,201,212,125,237,254,185,153,187,137,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51,
				115,246,180,62,27,101,169,86,135,9,2,212,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21,
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				135,166,57,162,46,147,154,236,121,113,121,78,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0
			};
			out.write_P(HTML_PAGE, (sizeof(HTML_PAGE)/sizeof(*HTML_PAGE)));
			out.flush();
			return;
		} else if (strcmp_P(command, PSTR("setDesiredTemperature")) == 0) {
			urlFound = true;
			int temperature = event->server->getIntParameterValue(event->url, "temperature");
			setDesiredTemperature(temperature);
		} else if (strcmp_P(command, PSTR("getDescriptors")) == 0) {
			printDescriptorsAsJson(&out);
			out.flush();
			return;
		} else if (strcmp_P(command, PSTR("getState")) == 0) {
			urlFound = true;
		}
		
		if (urlFound) {
			event->server->httpSuccess(&out);
			printStateAsJson(&out);
		} else {
			event->server->httpError404(&out);
		}
		out.flush();
	}
	
	void printDescriptorsAsJson(Print* print) {
		print->print(F("{\"inputs\":["));
		print->print(F("{\"label\":\"sensor\", \"property\":\"sensor\"}"));
		print->print(F(",{\"label\":\"relay\", \"property\":\"relay\"}"));

		print->print(F("],\"commands\":["));
		print->print(F("{\"label\":\"setDesiredTemperature\", \"command\":\"setDesiredTemperature\", \"parameters\":\"temperature:int\"}"));
		
		print->print(F("]}"));

	}
	
	void printStateAsJson(Print* print) {
		print->print(F("{"));
		sensor.printStateAsJson(F("sensor"), print);
		print->print(F(","));
		relay.printStateAsJson(F("relay"), print);
		print->print(F(","));
	
		write_P(print, PSTR("\"freeMem\": "));
		print->print(freeRam());
		print->print("}");
	}

	void setup() {
		sensor.contributesToState = true;
		sensor.pin = 5;
		sensor.pollInterval = 1000;
		sensor.onTemperatureChanged = new DelegatingCallback<AppGen, ValueChangedEvent>(this, &AppGen::sensor_onTemperatureChanged); 

		relay.contributesToState = true;
		relay.pin = 7;
		relay.initialValue = 1;

		httpServer.port = 80;
		httpServer.onCommandReceived = new DelegatingCallback<AppGen, HttpCommandEvent>(this, &AppGen::httpServer_onCommandReceived); 

		networkAdapter.ssid = "wifi-work";
		networkAdapter.password = "wifi-work-pass-123";
		networkAdapter.protocolHandler = &httpServer;
		networkAdapter.ipAddressStr = "192.168.100.252";

		timer.delay = 1000;
		timer.autoStart = true;
		timer.onTimer = new DelegatingCallback<AppGen, TimerEvent>(this, &AppGen::timer_onTimer); 

		sensor.setup();
		relay.setup();
		httpServer.setup();
		networkAdapter.setup();
		timer.setup();
	}

	void loop() {
		sensor.loop();
		relay.loop();
		httpServer.loop();
		networkAdapter.loop();
		timer.loop();
	}
	
};

#include "CustomCode.h"

App app;

void setup() {
	Serial.begin(115200);
	app.setup();
}

void loop() {
	app.loop();
}
